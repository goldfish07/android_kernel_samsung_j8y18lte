## arch/arm64/Kconfig.sec
```kconfig
config SEC_J8Y18LTE_PROJECT
	depends on ARCH_SDM450
	default n
	bool "Samsung J8Y18-LTE Project"
	help
	  Support for Samsung J8Y18-LTE Project
	  
config MACH_J8Y18LTE_SWA_INS 
	depends on SEC_J8Y18LTE_PROJECT
	default n
	bool "Samsung J8Y18-LTE SWA INS"
	help
	  Support for Samsung J8Y18-LTE SWA INS device.
	  
```
